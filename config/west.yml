## config/west.yml
```yaml
manifest:
  defaults:
    revision: v0.3

  projects:
    - name: zmk
      remote: zmkfirmware
      import: app/west.yml

  remotes:
    - name: zmkfirmware
      url-base: https://github.com/zmkfirmware

  self:
    path: config
```
